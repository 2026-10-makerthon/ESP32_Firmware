## firmware/main/Kconfig.projbuild
```kconfig
menu "Sound/haptic hardware adapters"
config SH_SYNTHETIC_AUDIO
    bool "Use synthetic 440 Hz bursts instead of a microphone"
    default y
config SH_SIMULATED_HAPTIC
    bool "Accept haptic commands using a log-only driver (no GPIO output)"
    default y
config SH_I2S_BCLK
    int "Microphone BCLK GPIO (candidate wiring; verify before use)"
    default 2
config SH_I2S_WS
    int "Microphone WS GPIO"
    default 1
config SH_I2S_DIN
    int "Microphone SD GPIO"
    default 4
config SH_POWER_BUTTON
    bool "Enable 3-second power / 6-second pairing button"
    default y
config SH_BUTTON_GPIO
    int "Active-low power button GPIO (XIAO D8)"
    default 7
    range 0 21
config SH_PAIRING_SECONDS
    int "New-device pairing window (seconds)"
    default 120
    range 10 600
endmenu
```

## firmware/sdkconfig.defaults
```kconfig
CONFIG_IDF_TARGET="esp32s3"
CONFIG_BT_ENABLED=y
CONFIG_BT_NIMBLE_ENABLED=y
CONFIG_BT_NIMBLE_MAX_CONNECTIONS=1
CONFIG_BT_NIMBLE_MAX_BONDS=1
CONFIG_BT_NIMBLE_NVS_PERSIST=y
CONFIG_BT_NIMBLE_SECURITY_ENABLE=y
CONFIG_BT_NIMBLE_SM_SC=y
CONFIG_BT_NIMBLE_SM_LEGACY=n
CONFIG_BT_NIMBLE_ATT_PREFERRED_MTU=247
CONFIG_BT_NIMBLE_MSYS_1_BLOCK_COUNT=32
CONFIG_BT_NIMBLE_MSYS_1_BLOCK_SIZE=256
CONFIG_FREERTOS_HZ=1000
CONFIG_ESP_MAIN_TASK_STACK_SIZE=8192
CONFIG_ESPTOOLPY_FLASHSIZE_4MB=y
CONFIG_SH_SYNTHETIC_AUDIO=y
CONFIG_SH_SIMULATED_HAPTIC=y
```
